## src/kernel/Kconfig
```kconfig
mainmenu "Lupos"

config LUPOS
	bool
	default y

menu "General setup"

menuconfig MODULES
	bool "Enable loadable module support"
	modules
	default y

config SMP
	bool "Symmetric multi-processing support"
	default y

config BLOCK
	bool "Enable the block layer"
	default y

endmenu

menu "Processor type and features"

config X86_64
	bool "x86-64 architecture support"
	default y

endmenu

menu "Bus support"

config PCI
	bool "PCI support"
	default y

config ACPI
	bool "ACPI support"
	default y

config IOMMU
	bool "IOMMU support"
	depends on PCI
	default n

endmenu

menu "Device Drivers"

config SERIAL_8250
	bool "8250/16550 serial port support"
	default y

config HW_RANDOM
	tristate "Hardware Random Number Generator Core support"
	default n

config NVRAM
	tristate "Non-volatile RAM support"
	default n

config CONNECTOR
	tristate "Connector - unified userspace <-> kernelspace linker"
	default n

config FRAMEBUFFER
	bool "Framebuffer console support"
	default y

config AGP
	tristate "/dev/agpgart (AGP support)"
	depends on PCI
	default m if MODULES
	default n

config AGP_AMD64
	tristate "AMD Opteron/Athlon64 on-CPU GART support"
	depends on AGP && PCI
	default m if MODULES
	default n

config AGP_INTEL
	tristate "Intel AGP chipset support"
	depends on AGP && PCI
	default m if MODULES
	default n

config DRM
	bool "Direct Rendering Manager support"
	depends on FRAMEBUFFER
	default y

config DRM_KMS_HELPER
	tristate
	depends on DRM
	default m if MODULES

config DRM_GEM_SHMEM_HELPER
	tristate
	depends on DRM
	default m if MODULES

config DRM_PANEL_ORIENTATION_QUIRKS
	tristate
	depends on DRM
	default m if MODULES

config DRM_BOCHS
	tristate "DRM Support for bochs dispi vga interface (qemu stdvga)"
	depends on DRM && PCI
	select DRM_KMS_HELPER
	select DRM_GEM_SHMEM_HELPER
	select DRM_PANEL_ORIENTATION_QUIRKS
	default m if MODULES

config DRM_I915
	tristate "Intel 915-family graphics support"
	depends on DRM && PCI
	select I2C
	select I2C_ALGOBIT
	default m if MODULES
	default n

config DRM_VIRTIO_GPU
	tristate "VirtIO GPU support"
	depends on DRM && VIRTIO && PCI
	default m if MODULES
	default n

config INPUT
	bool "Input device support"
	default y

config HID
	bool "HID bus support"
	depends on INPUT
	default y

config INPUT_EVDEV
	tristate "Event interface"
	depends on INPUT
	default n

config HID_GYRATION
	tristate "Gyration remote control"
	depends on HID
	default n

config HID_NTRIG
	tristate "N-Trig touch screen"
	depends on HID
	default n

config HID_PANTHERLORD
	tristate "Pantherlord/GreenAsia game controller"
	depends on HID
	default n

config HID_PETALYNX
	tristate "Petalynx Maxter remote control"
	depends on HID
	default n

config HID_SAMSUNG
	tristate "Samsung infrared remote control"
	depends on HID
	default n

config HID_SONY
	tristate "Sony controller"
	depends on HID
	default n

config HID_SUNPLUS
	tristate "Sunplus wireless desktop"
	depends on HID
	default n

config HID_TOPSEED
	tristate "TopSeed Cyberlink remote control"
	depends on HID
	default n

menu "I2C support"

config I2C
	tristate "I2C support"
	default n

config I2C_SMBUS
	tristate "SMBus-specific protocols"
	depends on I2C
	default n

config I2C_ALGOBIT
	tristate "I2C bit-banging interfaces"
	depends on I2C
	default n

config I2C_I801
	tristate "Intel 82801 (ICH/PCH) SMBus controller"
	depends on I2C && PCI
	select I2C_SMBUS
	default n

endmenu

menu "USB support"

config USB
	bool "USB support"
	default y

config USB_XHCI
	bool "xHCI host controller support"
	depends on USB && PCI
	default y

config USB_XHCI_HCD
	tristate "xHCI HCD (USB 3.0) support"
	depends on USB_XHCI && PCI
	default n

config USB_PCI
	bool "PCI based USB host interface"
	depends on USB && PCI
	default y

config USB_EHCI_HCD
	tristate "EHCI HCD (USB 2.0) support"
	depends on USB && PCI
	default n

config USB_EHCI_PCI
	tristate "EHCI support for PCI-bus USB controllers"
	depends on USB_EHCI_HCD && USB_PCI
	default n

config USB_OHCI_HCD
	tristate "OHCI HCD (USB 1.1) support"
	depends on USB && PCI
	default n

config USB_OHCI_HCD_PCI
	tristate "OHCI support for PCI-bus USB controllers"
	depends on USB_OHCI_HCD && USB_PCI
	default n

config USB_UHCI_HCD
	tristate "UHCI HCD (most Intel and VIA) support"
	depends on USB && PCI
	default n

config USB_MON
	tristate "USB Monitor support"
	depends on USB
	default n

config USB_PRINTER
	tristate "USB Printer support"
	depends on USB
	default n

endmenu

menu "Network device support"

config NET
	bool "Networking support"
	default y

config PACKET
	tristate "Packet socket"
	depends on NET
	default n

config XFRM_USER
	tristate "Transformation user configuration interface"
	depends on NET
	default n

config INET6_AH
	tristate "IPv6: AH transformation"
	depends on NET
	default n

config INET6_ESP
	tristate "IPv6: ESP transformation"
	depends on NET
	default n

config NF_CONNTRACK
	tristate "Netfilter connection tracking support"
	depends on NET
	default n

config NF_CONNTRACK_FTP
	tristate "FTP protocol support"
	depends on NF_CONNTRACK
	default n

config NF_CONNTRACK_IRC
	tristate "IRC protocol support"
	depends on NF_CONNTRACK
	default n

config NF_CONNTRACK_SIP
	tristate "SIP protocol support"
	depends on NF_CONNTRACK
	default n

config NF_CT_NETLINK
	tristate "Connection tracking netlink interface"
	depends on NF_CONNTRACK
	default n

config NF_NAT
	tristate "Netfilter NAT"
	depends on NF_CONNTRACK
	default n

config NETFILTER_XT_TARGET_CONNSECMARK
	tristate "CONNSECMARK target support"
	depends on NET
	default n

config NETFILTER_XT_TARGET_NFLOG
	tristate "NFLOG target support"
	depends on NET
	default n

config NETFILTER_XT_TARGET_SECMARK
	tristate "SECMARK target support"
	depends on NET
	default n

config NETFILTER_XT_TARGET_TCPMSS
	tristate "TCPMSS target support"
	depends on NET
	default n

config NETFILTER_XT_MATCH_CONNTRACK
	tristate "conntrack match support"
	depends on NF_CONNTRACK
	default n

config NETFILTER_XT_MATCH_POLICY
	tristate "IPsec policy match support"
	depends on NET
	default n

config NETFILTER_XT_MATCH_STATE
	tristate "state match support"
	depends on NF_CONNTRACK
	default n

config IP_NF_FILTER
	tristate "IPv4 packet filtering"
	depends on NET
	default n

config IP_NF_TARGET_REJECT
	tristate "IPv4 REJECT target"
	depends on IP_NF_FILTER
	default n

config IP_NF_MANGLE
	tristate "IPv4 packet mangling"
	depends on NET
	default n

config IP6_NF_MATCH_IPV6HEADER
	tristate "IPv6 header match"
	depends on NET
	default n

config IP6_NF_FILTER
	tristate "IPv6 packet filtering"
	depends on NET
	default n

config IP6_NF_TARGET_REJECT
	tristate "IPv6 REJECT target"
	depends on IP6_NF_FILTER
	default n

config IP6_NF_MANGLE
	tristate "IPv6 packet mangling"
	depends on NET
	default n

config NET_CLS_CGROUP
	tristate "Control Group Classifier"
	depends on NET
	default n

config CFG80211
	tristate "Wireless configuration API"
	depends on NET
	default n

config MAC80211
	tristate "Generic IEEE 802.11 Networking Stack"
	depends on CFG80211
	default n

config RFKILL
	tristate "RF switch subsystem support"
	depends on NET
	default n

config NETDEVICES
	bool "Network device support"
	depends on NET
	default y

config NETCONSOLE
	tristate "Network console logging support"
	depends on NETDEVICES
	default n

config NET_9P
	tristate "Plan 9 Resource Sharing Support (9P2000)"
	depends on NET
	default n

config NET_9P_VIRTIO
	tristate "9P Virtio Transport"
	depends on NET_9P && VIRTIO
	default n

config MII
	tristate
	depends on NETDEVICES
	default n

config PHYLIB
	tristate
	depends on NETDEVICES
	default n

config PHY_PACKAGE
	tristate
	depends on PHYLIB
	default n

config REALTEK_PHY
	tristate
	depends on PHYLIB
	select PHY_PACKAGE
	default n

config E100
	tristate "Intel(R) PRO/100+ support"
	depends on NETDEVICES && PCI
	select MII
	default n

config E1000
	tristate "Intel(R) PRO/1000 Gigabit Ethernet support"
	depends on NETDEVICES && PCI
	default m if MODULES

config E1000E
	tristate "Intel(R) PRO/1000 PCI-Express Gigabit Ethernet support"
	depends on NETDEVICES && PCI
	default n

config SKY2
	tristate "Marvell Yukon 2 support"
	depends on NETDEVICES && PCI
	default n

config TIGON3
	tristate "Broadcom Tigon3 support"
	depends on NETDEVICES && PCI
	select PHYLIB
	default n

config FORCEDETH
	tristate "nForce Ethernet support"
	depends on NETDEVICES && PCI
	default n

config 8139TOO
	tristate "RealTek RTL-8129/8130/8139 PCI Fast Ethernet Adapter support"
	depends on NETDEVICES && PCI
	select MII
	default n

config R8169
	tristate "Realtek 8169/8168/8101/8125 ethernet support"
	depends on NETDEVICES && PCI
	select PHYLIB
	select REALTEK_PHY
	default n

endmenu

menu "Thermal drivers"

config X86_THERMAL_VECTOR
	bool
	depends on X86_64
	default y

config INTEL_TCC
	bool
	depends on X86_64

config X86_PKG_TEMP_THERMAL
	tristate "X86 package temperature thermal driver"
	depends on X86_THERMAL_VECTOR && NET
	select INTEL_TCC
	default m if MODULES

config CPU_FREQ_GOV_ONDEMAND
	tristate "CPUfreq ondemand governor"
	depends on X86_64
	default n

endmenu

menu "Platform support"

config PCCARD
	tristate "PCCard (PCMCIA/CardBus) support"
	depends on PCI
	default n

config YENTA
	tristate "CardBus yenta-compatible bridge support"
	depends on PCCARD && PCI
	default n

config MAC_EMUMOUSEBTN
	tristate "Support for mouse button 2+3 emulation"
	default n

config EEEPC_LAPTOP
	tristate "Eee PC Hotkey Driver"
	depends on ACPI
	default n

endmenu

menu "Sound support"

config SOUND
	tristate "Sound card support"
	default m if MODULES
	default y

config SND
	tristate "Advanced Linux Sound Architecture"
	depends on SOUND
	default m if MODULES

config SND_TIMER
	tristate
	depends on SND
	default m if SND

config SND_HRTIMER
	tristate "HR-timer backend support"
	depends on SND
	select SND_TIMER
	default m if SND_SEQUENCER

config SND_SEQ_DEVICE
	tristate
	depends on SND
	default m if SND_SEQUENCER

config SND_SEQUENCER
	tristate "Sequencer support"
	depends on SND
	select SND_TIMER
	select SND_SEQ_DEVICE
	default m if MODULES

config SND_SEQ_DUMMY
	tristate "Sequencer dummy client"
	depends on SND_SEQUENCER
	default m if SND_SEQUENCER

config SND_PCM
	tristate
	depends on SND
	select SND_TIMER
	default m if SND

config SND_HWDEP
	tristate
	depends on SND
	default m if SND_HDA_HWDEP

config SND_HDA_CORE
	tristate
	depends on SND
	select SND_PCM
	default m if SND_HDA

config SND_INTEL_SOUNDWIRE_ACPI
	tristate
	depends on SND && ACPI
	default m if SND_INTEL_DSP_CONFIG

config SND_INTEL_DSP_CONFIG
	tristate
	depends on SND
	select SND_INTEL_SOUNDWIRE_ACPI if ACPI
	default m if SND_HDA_INTEL

config SND_HDA
	tristate
	depends on SND
	select SND_PCM
	select SND_HDA_CORE
	default m if SND_HDA_INTEL

config SND_HDA_HWDEP
	bool "Build hwdep interface for HD-audio driver"
	depends on SND_HDA
	select SND_HWDEP
	default y

config SND_HDA_INTEL
	tristate "Intel HD Audio support"
	depends on SND && PCI
	select SND_HDA
	select SND_INTEL_DSP_CONFIG
	default m if MODULES

config SND_HDA_GENERIC
	tristate "Generic HD-audio codec parser"
	depends on SND_HDA
	default m if SND_HDA_INTEL

endmenu

menu "SCSI and ATA storage"

config BLK_DEV_LOOP
	tristate "Loopback device support"
	depends on BLOCK
	default n

config BLK_DEV_MD
	tristate "Multiple devices driver support"
	depends on BLOCK
	default n

config BLK_DEV_DM
	tristate "Device mapper support"
	depends on BLOCK
	default n

config DM_MIRROR
	tristate "Mirror target"
	depends on BLK_DEV_DM
	default n

config DM_ZERO
	tristate "Zero target"
	depends on BLK_DEV_DM
	default n

config SCSI_COMMON
	tristate
	default m if MODULES

config SCSI
	tristate "SCSI device support"
	depends on BLOCK
	select SCSI_COMMON
	default m if MODULES

config BLK_DEV_SD
	tristate "SCSI disk support"
	depends on SCSI
	default m if MODULES

config CDROM
	tristate
	default m if BLK_DEV_SR

config BLK_DEV_SR
	tristate "SCSI CDROM support"
	depends on SCSI
	select CDROM
	default m if MODULES

config CHR_DEV_SG
	tristate "SCSI generic support"
	depends on SCSI
	default m if MODULES

config SCSI_SPI_ATTRS
	tristate "SCSI SPI transport attributes"
	depends on SCSI
	default m if MODULES

config SCSI_VIRTIO
	tristate "VirtIO SCSI support"
	depends on SCSI && VIRTIO
	default m if MODULES

config USB_STORAGE
	tristate "USB Mass Storage support"
	depends on SCSI && USB
	default m if MODULES

config ATA
	tristate "Serial ATA and Parallel ATA drivers"
	depends on BLOCK
	select SCSI
	default m if MODULES

config SATA_AHCI
	tristate "AHCI SATA support"
	depends on ATA && PCI
	default m if MODULES

config ATA_PIIX
	tristate "Intel ESB, ICH, PIIX3, PIIX4 PATA/SATA support"
	depends on ATA && PCI
	default m if MODULES

config PATA_AMD
	tristate "AMD/NVidia PATA support"
	depends on ATA && PCI
	default m if MODULES

config PATA_OLDPIIX
	tristate "Intel PIIX PATA support"
	depends on ATA && PCI
	default m if MODULES

config PATA_SCH
	tristate "Intel SCH PATA support"
	depends on ATA && PCI
	default m if MODULES

endmenu

menu "VirtIO drivers"

config VIRTIO
	bool "VirtIO support"
	default y

config VIRTIO_PCI_LIB
	tristate
	depends on VIRTIO && PCI
	default m if MODULES

config VIRTIO_PCI
	tristate "VirtIO PCI transport support"
	depends on VIRTIO && PCI
	select VIRTIO_PCI_LIB
	default m if MODULES

config VIRTIO_BLK
	tristate "VirtIO block driver"
	depends on VIRTIO_PCI
	default m if MODULES

config VIRTIO_NET
	tristate "VirtIO network driver"
	depends on VIRTIO_PCI && NETDEVICES
	default m if MODULES

config VIRTIO_CONSOLE
	tristate "VirtIO console"
	depends on VIRTIO
	default m if MODULES

config VIRTIO_INPUT
	tristate "VirtIO input driver"
	depends on VIRTIO && INPUT
	default m if MODULES

endmenu

endmenu
```
