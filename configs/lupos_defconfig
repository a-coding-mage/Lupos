## configs/lupos_defconfig
```kconfig
# Lupos default configuration — the single, generic x86_64 build.
#
# Source of truth: vendor/linux/arch/x86/configs/x86_64_defconfig. Core kernel
# symbols track upstream values. Device drivers that Lupos loads as Linux-built
# .ko payloads (CLAUDE.md 2a) are forced to =m instead of upstream's built-in =y,
# because Lupos does not reimplement drivers.
#
# Consumed by: make lupos_defconfig

CONFIG_MODULES=y
CONFIG_SMP=y
CONFIG_BLOCK=y
CONFIG_PCI=y
CONFIG_ACPI=y
CONFIG_SERIAL_8250=y
CONFIG_FRAMEBUFFER=y
CONFIG_DRM=y
CONFIG_INPUT=y
CONFIG_HID=y
CONFIG_USB=y
CONFIG_USB_XHCI=y
CONFIG_NET=y
CONFIG_NETDEVICES=y
CONFIG_VIRTIO=y

# Drivers built as external Linux .ko payloads (=m; CLAUDE.md 2a).
CONFIG_I2C=m
CONFIG_I2C_SMBUS=m
CONFIG_I2C_I801=m
CONFIG_SOUND=m
CONFIG_SND=m
CONFIG_SND_TIMER=m
CONFIG_SND_HRTIMER=m
CONFIG_SND_SEQ_DEVICE=m
CONFIG_SND_SEQUENCER=m
CONFIG_SND_SEQ_DUMMY=m
CONFIG_SND_PCM=m
CONFIG_SND_HWDEP=m
CONFIG_SND_HDA_CORE=m
CONFIG_SND_INTEL_SOUNDWIRE_ACPI=m
CONFIG_SND_INTEL_DSP_CONFIG=m
CONFIG_SND_HDA=m
CONFIG_SND_HDA_HWDEP=y
CONFIG_SND_HDA_INTEL=m
CONFIG_SND_HDA_GENERIC=m
CONFIG_AGP=m
CONFIG_AGP_AMD64=m
CONFIG_AGP_INTEL=m
CONFIG_DRM_KMS_HELPER=m
CONFIG_DRM_GEM_SHMEM_HELPER=m
CONFIG_DRM_PANEL_ORIENTATION_QUIRKS=m
CONFIG_DRM_BOCHS=m
CONFIG_DRM_I915=m
CONFIG_DRM_VIRTIO_GPU=m
CONFIG_SCSI_COMMON=m
CONFIG_SCSI=m
CONFIG_BLK_DEV_SD=m
CONFIG_CDROM=m
CONFIG_BLK_DEV_SR=m
CONFIG_CHR_DEV_SG=m
CONFIG_SCSI_SPI_ATTRS=m
CONFIG_SCSI_VIRTIO=m
CONFIG_USB_MON=m
CONFIG_USB_EHCI_HCD=m
CONFIG_USB_EHCI_PCI=m
CONFIG_USB_OHCI_HCD=m
CONFIG_USB_OHCI_HCD_PCI=m
CONFIG_USB_UHCI_HCD=m
CONFIG_USB_PRINTER=m
CONFIG_USB_STORAGE=m
CONFIG_ATA=m
CONFIG_SATA_AHCI=m
CONFIG_ATA_PIIX=m
CONFIG_PATA_AMD=m
CONFIG_PATA_OLDPIIX=m
CONFIG_PATA_SCH=m
CONFIG_VIRTIO_PCI_LIB=m
CONFIG_VIRTIO_PCI=m
CONFIG_VIRTIO_BLK=m
CONFIG_VIRTIO_CONSOLE=m
CONFIG_VIRTIO_INPUT=m
CONFIG_VIRTIO_NET=m
CONFIG_NETCONSOLE=m
CONFIG_NET_9P=m
CONFIG_NET_9P_VIRTIO=m
CONFIG_MII=m
CONFIG_PHYLIB=m
CONFIG_PHY_PACKAGE=m
CONFIG_REALTEK_PHY=m
CONFIG_E100=m
CONFIG_E1000=m
CONFIG_E1000E=m
CONFIG_SKY2=m
CONFIG_TIGON3=m
CONFIG_FORCEDETH=m
CONFIG_8139TOO=m
CONFIG_R8169=m
CONFIG_X86_PKG_TEMP_THERMAL=m

# Additional module-capable symbols present in Linux's generic x86_64 defconfig.
CONFIG_PACKET=m
CONFIG_XFRM_USER=m
CONFIG_INET6_AH=m
CONFIG_INET6_ESP=m
CONFIG_NF_CONNTRACK=m
CONFIG_NF_CONNTRACK_FTP=m
CONFIG_NF_CONNTRACK_IRC=m
CONFIG_NF_CONNTRACK_SIP=m
CONFIG_NF_CT_NETLINK=m
CONFIG_NF_NAT=m
CONFIG_NETFILTER_XT_TARGET_CONNSECMARK=m
CONFIG_NETFILTER_XT_TARGET_NFLOG=m
CONFIG_NETFILTER_XT_TARGET_SECMARK=m
CONFIG_NETFILTER_XT_TARGET_TCPMSS=m
CONFIG_NETFILTER_XT_MATCH_CONNTRACK=m
CONFIG_NETFILTER_XT_MATCH_POLICY=m
CONFIG_NETFILTER_XT_MATCH_STATE=m
CONFIG_IP_NF_FILTER=m
CONFIG_IP_NF_TARGET_REJECT=m
CONFIG_IP_NF_MANGLE=m
CONFIG_IP6_NF_MATCH_IPV6HEADER=m
CONFIG_IP6_NF_FILTER=m
CONFIG_IP6_NF_TARGET_REJECT=m
CONFIG_IP6_NF_MANGLE=m
CONFIG_NET_CLS_CGROUP=m
CONFIG_CFG80211=m
CONFIG_MAC80211=m
CONFIG_RFKILL=m
CONFIG_BLK_DEV_LOOP=m
CONFIG_BLK_DEV_MD=m
CONFIG_BLK_DEV_DM=m
CONFIG_DM_MIRROR=m
CONFIG_DM_ZERO=m
CONFIG_CONNECTOR=m
CONFIG_INPUT_EVDEV=m
CONFIG_HW_RANDOM=m
CONFIG_NVRAM=m
CONFIG_HID_GYRATION=m
CONFIG_HID_NTRIG=m
CONFIG_HID_PANTHERLORD=m
CONFIG_HID_PETALYNX=m
CONFIG_HID_SAMSUNG=m
CONFIG_HID_SONY=m
CONFIG_HID_SUNPLUS=m
CONFIG_HID_TOPSEED=m
CONFIG_USB_XHCI_HCD=m
CONFIG_CPU_FREQ_GOV_ONDEMAND=m
CONFIG_PCCARD=m
CONFIG_YENTA=m
CONFIG_MAC_EMUMOUSEBTN=m
CONFIG_EEEPC_LAPTOP=m
```
